## Documentation/devicetree/bindings/iio/frequency/adi,adf41513.yaml
```yaml
# SPDX-License-Identifier: (GPL-2.0-only OR BSD-2-Clause)
%YAML 1.2
---
$id: http://devicetree.org/schemas/iio/frequency/adi,adf41513.yaml#
$schema: http://devicetree.org/meta-schemas/core.yaml#

title: Analog Devices ADF41513 PLL Frequency Synthesizer

maintainers:
  - Rodrigo Alencar <rodrigo.alencar@analog.com>
  - Dragos Bogdan <dragos.bogdan@analog.com>

description: |
  The ADF41513 is an ultralow noise frequency synthesizer that can be used to
  implement local oscillators (LOs) as high as 26.5 GHz in the upconversion and
  downconversion sections of wireless receivers and transmitters.

  https://www.analog.com/en/products/adf41513.html

properties:
  compatible:
    enum:
      - adi,adf41510
      - adi,adf41513

  reg:
    maxItems: 1

  spi-max-frequency:
    maximum: 25000000

  clocks:
    maxItems: 1
    description: Clock that provides the reference input frequency.

  clock-names:
    const: refin

  '#clock-cells':
    const: 0

  clock-output-names:
    maxItems: 1

  adi,power-up-frequency:
    $ref: /schemas/types.yaml#/definitions/uint64
    description:
      If set, the PLL tunes to this frequency (in Hz) on driver probe.
      Range is 1 GHz to 26.5 GHz for ADF41513, and 1 GHz to 10 GHz for ADF41510.

  adi,reference-div-factor:
    $ref: /schemas/types.yaml#/definitions/uint32
    minimum: 1
    maximum: 32
    description:
      Reference division factor (R Counter). If not specified, the driver
      will calculate the optimal value automatically.

  adi,reference-doubler-enable:
    $ref: /schemas/types.yaml#/definitions/flag
    description:
      Enables the reference doubler. The maximum reference frequency when
      the doubler is enabled is 225 MHz.

  adi,reference-div2-enable:
    $ref: /schemas/types.yaml#/definitions/flag
    description:
      Enables the reference divide-by-2 function. This provides a 50%
      duty cycle signal to the PFD.

  adi,charge-pump-current:
    $ref: /schemas/types.yaml#/definitions/uint32
    minimum: 450
    maximum: 7200
    description:
      Charge pump current in microamps. The value will be rounded to the
      nearest supported value. Default is 2400 �A.

  adi,muxout-select:
    $ref: /schemas/types.yaml#/definitions/uint32
    minimum: 0
    maximum: 10
    description: |
      Multiplexer output selection. Valid values are:
      0: Tristate (default)
      1: Digital lock detect
      2: Charge pump up
      3: Charge pump down
      4: RDIV2
      5: N divider output
      6: VCO test
      7: Reserved
      8: High
      9: VCO calibration R band
      10: VCO calibration N band

  adi,phase-detector-polarity-positive:
    $ref: /schemas/types.yaml#/definitions/flag
    description:
      Set phase detector polarity to positive. Default is negative.
      Use positive polarity with non-inverting loop filter and VCO with
      positive tuning slope, or with inverting loop filter and VCO with
      negative tuning slope.

  adi,lock-detect-precision:
    $ref: /schemas/types.yaml#/definitions/uint32
    minimum: 0
    maximum: 3
    description:
      Lock detector precision setting. Higher values provide more precise
      lock detection but may increase lock time.

  adi,lock-detect-count:
    $ref: /schemas/types.yaml#/definitions/uint32
    minimum: 2
    maximum: 8192
    description:
      Number of consecutive phase detector cycles that must be within the
      lock detector window before lock is declared. Default is based on
      the lock detector precision setting.

  adi,target-resolution-hz:
    $ref: /schemas/types.yaml#/definitions/uint64
    description:
      Target frequency resolution in Hz for the algorithm to achieve.
      This influences the choice between fixed and variable modulus modes.
      Default is 1 Hz.

required:
  - compatible
  - reg
  - clocks

allOf:
  - $ref: /schemas/spi/spi-peripheral-props.yaml#

unevaluatedProperties: false

examples:
  - |
    spi {
        #address-cells = <1>;
        #size-cells = <0>;

        pll@0 {
            compatible = "adi,adf41513";
            reg = <0>;
            spi-max-frequency = <10000000>;
            clocks = <&ref_clk>;
            clock-names = "refin";
            #clock-cells = <0>;

            adi,power-up-frequency = /bits/ 64 <12000000000>;
            adi,charge-pump-current = <2400>;
            adi,phase-detector-polarity-positive;
            adi,mute-till-lock-enable;
        };
    };
  - |
    spi {
        #address-cells = <1>;
        #size-cells = <0>;

        /* Example with algorithm optimization enabled */
        pll_optimized@0 {
            compatible = "adi,adf41513";
            reg = <0>;
            spi-max-frequency = <10000000>;
            clocks = <&ref_clk>;
            clock-names = "refin";
            #clock-cells = <0>;

            adi,power-up-frequency = /bits/ 64 <15500000000>;
            adi,auto-prescaler-enable;
            adi,optimize-pfd-enable;
            adi,target-resolution-hz = /bits/ 64 <1>;
            adi,phase-detector-polarity-positive;
        };
    };
...
```

## Documentation/devicetree/bindings/leds/leds-ltc3220.yaml
```yaml
# SPDX-License-Identifier: (GPL-2.0-only OR BSD-2-Clause)
%YAML 1.2
---
$id: http://devicetree.org/schemas/leds/leds-ltc3220.yaml#
$schema: http://devicetree.org/meta-schemas/core.yaml#

title: Analog Devices LTC3220 LED Drivers

maintainers:
  - Edelweise Escala <edelweise.escala@analog.com>

description: |
  Bindings for the Analog Devices LTC3220 18 channel
  LED Drivers.

  For more product information please see the link below:
    https://www.analog.com/en/products/ltc3220.html

properties:
  compatible:
    enum:
      - lltc,ltc3220
      - lltc,ltc3220-1

  reg:
    maxItems: 1
    description: |
      I2C slave address
      0x1c for ltc3220
      0x1d for ltc3220-1

  '#address-cells':
    const: 1

  '#size-cells':
    const: 0

  reset-gpios:
    maxItems: 1
    description: |
      GPIO attached to the chip's reset pin

patternProperties:
  "(^led@[0-9a-f]$|led)":
    type: object
    $ref: common.yaml#
    properties:
      reg:
        description: |
          Output channel for the LED.
          reg value to output to LED output number
        enum:
          - 1  # LED output D1
          - 2  # LED output D2
          - 3  # LED output D3
          - 4  # LED output D4
          - 5  # LED output D5
          - 6  # LED output D6
          - 7  # LED output D7
          - 8  # LED output D8
          - 9  # LED output D9
          - 10 # LED output D10
          - 11 # LED output D11
          - 12 # LED output D12
          - 13 # LED output D13
          - 14 # LED output D14
          - 15 # LED output D15
          - 16 # LED output D16
          - 17 # LED output D17
          - 18 # LED output D18

required:
  - compatible
  - reg
  - reset-gpios

additionalProperties: false

examples:
  - |
   #include <dt-bindings/leds/common.h>

   i2c {
       #address-cells = <1>;
       #size-cells = <0>;

       led-controller@1c {
             compatible = "lltc,ltc3220";
             reg = <0x1c>;
             #address-cells = <1>;
             #size-cells = <0>;
             reset-gpios = <&gpio 17 0>;

             led@1 {
                 reg = <1>;
             };

             led@2 {
                 reg = <2>;
             };

             led@3 {
                 reg = <3>;
             };

             led@4 {
                 reg = <4>;
             };

             led@5 {
                 reg = <5>;
             };

             led@6 {
                 reg = <6>;
             };

             led@7 {
                 reg = <7>;
             };

             led@8 {
                 reg = <8>;
             };

             led@9 {
                 reg = <9>;
             };

             led@10 {
                 reg = <10>;
             };

             led@11 {
                 reg = <11>;
             };

             led@12 {
                 reg = <12>;
             };

             led@13 {
                 reg = <13>;
             };

             led@14 {
                 reg = <14>;
             };

             led@15 {
                 reg = <15>;
             };

             led@16 {
                 reg = <16>;
             };

             led@17 {
                 reg = <17>;
             };

             led@18 {
                 reg = <18>;
             };
        };
    };

...
```

## drivers/iio/trx-rf/Kconfig
```kconfig
# SPDX-License-Identifier: GPL-2.0-only
#
# RF Trnasceivers and Advacend Mixed Signal Frontends drivers
#
menu "RF Transceivers and Advacend Mixed Signal Frontends"

config ADRV9102
	tristate ""
	depends on SPI
	select IIO_BACKEND
	help
	  Say yes to build support for the Analog Devices ADRV9102 integrated
	  RF transceiver and similar devices.

	  To compile this driver as a module, choose M here: the module will be
	  called adrv9102

endmenu
```
